/dts-v1/;
/plugin/;

/* ExoPet HAT device-tree fragment, embedded in the HAT EEPROM.
 * Loaded automatically by the firmware at boot: enables the 1-Wire
 * bus on GPIO4 for the DS18B20 on the TEMP terminal. No manual
 * config.txt dtoverlay line needed on provisioned HATs. */

/ {
	compatible = "brcm,bcm2835";

	fragment@0 {
		target-path = "/";
		__overlay__ {
			w1: onewire@0 {
				compatible = "w1-gpio";
				pinctrl-names = "default";
				pinctrl-0 = <&w1_pins>;
				gpios = <&gpio 4 0>;
				status = "okay";
			};
		};
	};

	fragment@1 {
		target = <&gpio>;
		__overlay__ {
			w1_pins: w1_pins@0 {
				brcm,pins = <4>;
				brcm,function = <0>; /* input */
				brcm,pull = <0>;     /* external 4.7k pullup on the HAT */
			};
		};
	};
};
